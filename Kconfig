## Kconfig
```kconfig
mainmenu "Borslade/Tailwind Configuration"

menu "Memory Configuration"
    choice
        prompt "Paging System"
        default IDENTITY_MAP

        config IDENTITY_MAP
            bool "Identity-mapped"
    endchoice

    config ALIGNED_ALLOC
        bool "Aligned Allocation"
        default y

    config FALLBACK_PCIE_ECAM
        hex "Fallback PCIe ECAM"
        default 0xE0000000

    config HEAP_SIZE
        hex "Kernel Heap Size in MB"
        default 0x80
endmenu

menu "Kernel Type"
    config VERBOSE
        bool "Verbose Kernel"
        default y

    config PMM_VERBOSE
        bool "PMM Verbose (Very Noisy)"
        default n
endmenu
```
